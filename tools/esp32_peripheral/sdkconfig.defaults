## tools/esp32_peripheral/sdkconfig.defaults
```kconfig
# Bluebird BLE peripheral test fixture — ESP32-S3 + NimBLE (Bluedroid disabled)
CONFIG_IDF_TARGET="esp32s3"

#
# Bluetooth
#
CONFIG_BT_ENABLED=y
CONFIG_BT_BLUEDROID_ENABLED=n
CONFIG_BT_NIMBLE_ENABLED=y

# Persist bonds/CCCDs in NVS so bonding survives reboots
CONFIG_BT_NIMBLE_NVS_PERSIST=y

# Security: LE Secure Connections (Just Works pairing is configured in code)
CONFIG_BT_NIMBLE_SM_SC=y

# Preferred / maximum ATT MTU
CONFIG_BT_NIMBLE_ATT_PREFERRED_MTU=517

# L2CAP connection-oriented channels (CoC) — enables the echo server on PSM
# 0x0080 (see main/l2cap_svr.c). MAX_NUM is the number of simultaneous CoC
# channels the host supports.
CONFIG_BT_NIMBLE_L2CAP_COC_MAX_NUM=1
```
